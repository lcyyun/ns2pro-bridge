## firmware/esp32s3/boards/n8r2/sdkconfig.defaults
```kconfig
# ESP32-S3 modules with 8 MB Quad SPI flash and 2 MB Quad SPI PSRAM.

CONFIG_ESPTOOLPY_FLASHSIZE_8MB=y
CONFIG_ESPTOOLPY_FLASHSIZE="8MB"
CONFIG_ESPTOOLPY_FLASHMODE_DIO=y
CONFIG_ESPTOOLPY_FLASHMODE="dio"
CONFIG_ESPTOOLPY_FLASHFREQ_80M=y
CONFIG_ESPTOOLPY_FLASHFREQ="80m"

CONFIG_SPIRAM=y
CONFIG_SPIRAM_MODE_QUAD=y
CONFIG_SPIRAM_TYPE_AUTO=y
CONFIG_SPIRAM_SPEED_80M=y
CONFIG_SPIRAM_SPEED=80
CONFIG_SPIRAM_BOOT_INIT=y
CONFIG_SPIRAM_USE_MALLOC=y
CONFIG_SPIRAM_MEMTEST=y
```

## firmware/esp32s3/main/Kconfig.projbuild
```kconfig
menu "NS2 ESP32-S3 board controls"

config NS2_BOOT_BUTTON_GPIO
    int "BOOT button GPIO"
    default 0
    help
        GPIO used by the board BOOT button. ESP32-S3 boards usually wire BOOT
        to GPIO0 active-low.

config NS2_STATUS_LED_ENABLE
    bool "Enable status RGB LED"
    default y

config NS2_STATUS_LED_GPIO
    int "Status RGB LED GPIO"
    depends on NS2_STATUS_LED_ENABLE
    default 48
    help
        GPIO for the onboard addressable RGB LED. ESP32-S3 SuperMini boards
        commonly use GPIO48.

endmenu
```
